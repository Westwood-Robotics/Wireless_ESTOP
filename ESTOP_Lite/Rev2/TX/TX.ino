/*
__author__ = "Xiaoguang Zhang"
__email__ = "xzhang@westwoodrobotics.io"
__copyright__ = "Copyright 2021~2024 Westwood Robotics"
__date__ = "March. 07, 2024"

__version__ = "2.1.1"
__status__ = "Production" 
*/
#include "stdio.h"
#include "pico/stdlib.h"
#include "hardware/spi.h" 
#include "pico/binary_info.h"

#include <nRF24L01.h>

//OLED
#include "Wire.h"
#include <Adafruit_GFX.h>
#include <Adafruit_SSD1306.h>
#include <Fonts/FreeSerif9pt7b.h>
#define OLED_WIDTH 128 
#define OLED_HEIGHT 64 
#define OLED_PIN_SDA 14
#define OLED_PIN_SCL 15
#define OLED_PIN_RESET -1
#define OLED_I2C_ADDRESS 0x3C
Adafruit_SSD1306 display = Adafruit_SSD1306(OLED_WIDTH, OLED_HEIGHT, &Wire1, OLED_PIN_RESET);
// NRF24L01
#define PIN_SCK 2  
#define PIN_MOSI 3
#define PIN_MISO 4
#define PIN_CSN 5
#define PIN_CE 19
//#define PIN_IRQ 5
// Others
#define PIN_SSTOP_IN     8  //S-ESTOP Signal Input
#define PIN_SSTOP_OUT    13 //S-ESTOP Execution Signal Output
#define PIN_STOP_IN      9  //PWR-ESTOP Signal Input !!!not in use!!!
#define PIN_STOP_LED     10 //PWR-ESTOP Status LED !!!not in use!!!
#define PIN_SSTOP_LED    6  //S-ESTOP Status LED
#define PIN_STATUS       7  //offline Status LED
#define loop_time        2000 // Loop time control (us)
#define FILTER_MAX_COUNT 100 // remote filter max count

#define TX_ADR_WIDTH 5
#define TX_PLOAD_WIDTH 6

unsigned char txbuf[TX_PLOAD_WIDTH];
unsigned char rxbuf[TX_PLOAD_WIDTH]; 

unsigned char ADDRESS1[TX_ADR_WIDTH] = {0x78,0x78,0x78,0x78,0x78};
unsigned char ADDRESS2[TX_ADR_WIDTH] = {0xC2,0xC2,0xC2,0xC2,0xC2};

// logo
const unsigned char logo [] PROGMEM = {
	0x00, 0x00, 0x00, 0x00, 0x00, 0x00, 0x00, 0x00, 0x00, 0x00, 0x00, 0x00, 0x00, 0x00, 0x00, 0x00, 
	0x00, 0x00, 0x00, 0x00, 0x00, 0x00, 0x00, 0x00, 0x00, 0x00, 0x00, 0x00, 0x00, 0x00, 0x00, 0x00, 
	0x1e, 0x00, 0x00, 0x07, 0xfe, 0x00, 0x00, 0x00, 0x00, 0x00, 0x00, 0x00, 0x00, 0x00, 0x00, 0x00, 
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	0x00, 0x00, 0x00, 0x00, 0x00, 0x00, 0x00, 0x00, 0x00, 0x00, 0x00, 0x00, 0x00, 0x00, 0x00, 0x00
};

// Global variables
uint8_t local_status = 0b00000000;  // LSB->MSB: STOP, SSTOP
uint8_t remote_status = 0b00000000; // LSB->MSB: STOP, SSTOP
uint8_t switch_status = 0b00000000; // LSB->MSB: STOP, SSTOP
uint8_t error = 1;
long global_time = 0;
uint8_t error_timeout = 1;

// OLED
int display_mode = 2;  // ESTOP OFF - 0; ESTOP ON - 1; OFFLINE - 2

//Display Status
void display_status() {
  if (error_timeout) {
    display_mode = 2;
    display_offline();
  } else if ((local_status & 0b00000010) && (display_mode != 1)) {
    display_mode = 1;
    display_estop_on();
  } else if (!(local_status & 0b00000010) && (display_mode != 0)) {
    display_mode = 0;
    display_estop_off();
  }
}

//Display ESTOP Status
void display_estop_on() {
  display.setTextSize(2);
  display.setTextColor(WHITE);
  display.setCursor(0, 0);
  display.print("ESTOP:");
  display.print("ON");
  display.display();
  display.clearDisplay();
}

void display_estop_off() {
  display.setTextSize(2);
  display.setTextColor(WHITE);
  display.setCursor(0, 0);
  display.print("ESTOP:");
  display.print("OFF");
  display.display();
  display.clearDisplay();
}

void display_offline() {
  display.setTextSize(2);
  display.setTextColor(WHITE);
  display.setCursor(0, 0);
  display.print("OFFLINE!");
  display.display();
  display.clearDisplay();
}

//Data Write
int reg_write(spi_inst_t* spi,
              const uint8_t reg,
              uint8_t *buf,
              const uint8_t nbytes) {  
           
    int num_bytes_write = 0;
    uint8_t msg[nbytes + 1];

    if(nbytes < 1) {
        return 0;
   }

    msg[0] = reg;
    for(int i = 0; i < nbytes; i++) {
      msg[i + 1] = buf[i];
    }
    gpio_put(PIN_CSN,0);
    num_bytes_write = spi_write_blocking(spi, msg, (nbytes + 1));
    gpio_put(PIN_CSN,1);

    return num_bytes_write;
}


//Data Read
int reg_read( spi_inst_t* spi,
              const uint8_t reg,
              uint8_t *buf,
              const uint8_t nbytes) {

    int num_bytes_read = 0;

    if (nbytes < 1) {
        return 0;
    }
    
    gpio_put(PIN_CSN,0);
    num_bytes_read = spi_read_blocking(spi, reg, buf, nbytes);
    gpio_put(PIN_CSN,1);
    return num_bytes_read;
} 


//Write Reg（for config Registers）
static void write_register(uint8_t reg, uint8_t data) {
    uint8_t buf[2];
    buf[0] = reg;
    buf[1] = data;
    gpio_put(PIN_CSN,0);
    spi_write_blocking(spi0, buf, 2);
    gpio_put(PIN_CSN,1);
}


//Read Reg（for config Registers）
static void read_register(uint8_t reg, uint8_t *buf, uint16_t len) {
    gpio_put(PIN_CSN,0);
    spi_read_blocking(spi0, reg, buf, len);
    gpio_put(PIN_CSN,1);
}

uint8_t get_swtich_status(uint8_t SSTOP, uint8_t ESTOP){
  // get swtich status
  uint8_t SSTOP_status = gpio_get(SSTOP);
  uint8_t ESTOP_status = gpio_get(ESTOP);
  uint8_t local = 0;
  local = (SSTOP_status<<1) | ESTOP_status;
  return local;   
}


void setup() {
    //Init spi0
    spi_init(spi0,1000*1000);
    Serial.begin(9600);

    //Turn on Screen
    Wire1.setSDA(OLED_PIN_SDA);
    Wire1.setSCL(OLED_PIN_SCL);
    Wire1.begin();
    display.begin(SSD1306_SWITCHCAPVCC, OLED_I2C_ADDRESS);
    display.clearDisplay();
    display.display();
    delay(100);

    //Display logo
    display.drawBitmap(0, 0, logo, OLED_WIDTH, OLED_HEIGHT, WHITE);
    display.setFont(&FreeSerif9pt7b);
    display.setTextSize(1);
    display.setTextColor(WHITE);
    display.setCursor(1, 54);
    display.print("Wireless ESTOP");
    display.display();
    display.clearDisplay();
    display.setFont(NULL);
    delay(2000);
    
    //GPIO SPI
    gpio_set_function(PIN_SCK,GPIO_FUNC_SPI);
    gpio_set_function(PIN_MOSI,GPIO_FUNC_SPI);
    gpio_set_function(PIN_MISO,GPIO_FUNC_SPI);

    //Pull-up SPI
    gpio_pull_up(PIN_MISO);
    gpio_pull_up(PIN_MOSI);
    gpio_pull_down(PIN_SCK);

    //CSN and CE pins
    gpio_init(PIN_CSN);
    gpio_set_dir(PIN_CSN,GPIO_OUT);
    gpio_put(PIN_CSN,1);
    gpio_init(PIN_CE);
    gpio_set_dir(PIN_CE,GPIO_OUT);
    gpio_put(PIN_CE,0);

//    //IRQ pin for DATA Sent Success
//    gpio_init(PIN_IRQ);
//    gpio_set_dir(PIN_IRQ,GPIO_IN);

    delay(1000);

    //TX Config
    reg_write(spi0,W_REGISTER+TX_ADDR,ADDRESS1,TX_ADR_WIDTH);
    reg_write(spi0,W_REGISTER+RX_ADDR_P0,ADDRESS1,TX_ADR_WIDTH);
    
    //Reg. Config
    uint8_t CONFIG2 = 0x01;  //Auto Acknoledge(P0)
    write_register(W_REGISTER+EN_AA, CONFIG2);
 
//    uint8_t CONFIG3 = 0x03;  //Address Size(5 Bytes)
//    write_register(W_REGISTER+SETUP_AW, CONFIG3);   
      
    uint8_t CONFIG4 = 0x02;  //Auto Resend twice
    write_register(W_REGISTER+SETUP_RETR, CONFIG4);
    
    uint8_t CONFIG5 = 0x00;  //Channel Freq
    write_register(W_REGISTER+RF_CH, CONFIG5);
    
    uint8_t CONFIG6 = 0x0F;  //RF_SETUP
    write_register(W_REGISTER+RF_SETUP, CONFIG6);
    
    uint8_t CONFIG7 = 0x01;  //RX Address(pipe 0)
    write_register(W_REGISTER+EN_RXADDR, CONFIG7); 
     
    uint8_t CONFIG1 = 0b00101010;  //Set as TX+MASK_TX_DS
    write_register(W_REGISTER+NRF_CONFIG, CONFIG1);

    uint8_t CONFIG_FEATURE = 0b00000110; // DPL, Payload with ACK
    write_register(W_REGISTER+0x1D, CONFIG_FEATURE);

    uint8_t CONFIG_DYNPD = 0x01; // En. DPL on pipe 0
    write_register(W_REGISTER+0x1C, CONFIG_DYNPD);

    gpio_put(PIN_CE,1); // TODO: work on this part for stand-by and power saving

    write_register(FLUSH_TX,0xFF);
    write_register(FLUSH_RX,0xFF);

    // Buttons and LEDs
    gpio_init(PIN_STOP_IN);      
    gpio_set_dir(PIN_STOP_IN,GPIO_IN);
    gpio_pull_up(PIN_STOP_IN);

    gpio_init(PIN_SSTOP_IN);      
    gpio_set_dir(PIN_SSTOP_IN,GPIO_IN);
    gpio_pull_up(PIN_SSTOP_IN);

    gpio_init(PIN_STOP_LED);
    gpio_set_dir(PIN_STOP_LED,GPIO_OUT);
    gpio_put(PIN_STOP_LED,0);
    
    gpio_init(PIN_SSTOP_LED);
    gpio_set_dir(PIN_SSTOP_LED,GPIO_OUT);
    gpio_put(PIN_SSTOP_LED,0);

    // Signal ports        
    gpio_init(PIN_SSTOP_OUT);
    gpio_set_dir(PIN_SSTOP_OUT,GPIO_OUT);
    gpio_put(PIN_SSTOP_OUT,0);

    gpio_init(PIN_STATUS);
    gpio_set_dir(PIN_STATUS,GPIO_OUT);
    gpio_put(PIN_STATUS,0);
    
    gpio_put(PIN_STATUS,1);
    delay(500);
    global_time = micros();

}

void loop() {  
  int t = micros();
  bool ot = false;  
  error_timeout = 0;
  switch_status = get_swtich_status(PIN_SSTOP_IN, PIN_STOP_IN);
  txbuf[0] = switch_status;
  // Check if TX full
  reg_read(spi0, R_REGISTER+FIFO_STATUS, rxbuf, 2);
  if(rxbuf[0]&0x01){
    // TX full
    write_register(FLUSH_TX,0xFF);
  }
  // Check if RX full
  if(rxbuf[1] & 0b00000010){
    // RX full
    write_register(FLUSH_RX,0xFF);
  }
  
  reg_write(spi0, W_TX_PAYLOAD, txbuf, 1);  //Data Send

  // Monitor IRQ
  // uint8_t TX_DS_IRQ = gpio_get(PIN_IRQ);
  while(true){
    reg_read(spi0, R_REGISTER+FIFO_STATUS, rxbuf, 2);
//    Serial.print("STATUS:  ");
//    Serial.print(rxbuf[0]);
//    Serial.print("   FIFO STATUS:  ");
//    Serial.println(rxbuf[1]);
//    // Check if RX_DR
//    if(rxbuf[0] & 0b01000000){
//      // RX_DR noticed
////      Serial.println("RX_DR noticed but no TX_DS.");
//    }
    // Check if RX_DR
    if(rxbuf[0] & 0b00100000){
      // TX_DS noticed
      Serial.println("TX_DS.");
      break;
    }     
    // Check if RX full
    if(rxbuf[1] & 0b00000010){
      // RX full but no new data
      write_register(FLUSH_RX,0xFF);
    }
    // Check if TX Empty
    if(rxbuf[1] & 0b00010000){
      // TX Empty
      reg_write(spi0, W_TX_PAYLOAD, txbuf, 1);  //Data Send
    }
    delayMicroseconds(100);
    // TX_DS_IRQ = gpio_get(PIN_IRQ);
    if(micros()-t>loop_time){
      ot = true;       
      break;
    }
  }
  // Out of loop
  if(ot){
    // Overtime
    if(micros()-global_time > 500000){
      // It's been overtime for more than 500ms(500,000us)
      Serial.println("Overtime.\n");
      error = 1; 
      error_timeout = 1;
    }
  }
  else{
    // TX_DS pulled low or noticed
    Serial.println("TX_DS low or bit noticed.");
    // Read ACK payload
    reg_read(spi0, R_RX_PAYLOAD, rxbuf, 2);
    remote_status = rxbuf[1];
    local_status = switch_status | remote_status;
    error = local_status >> 2;
    global_time = micros();
  }
  
  write_register(W_REGISTER+NRF_STATUS, rxbuf[0]);
  write_register(FLUSH_TX,0xFF);
  write_register(FLUSH_RX,0xFF);  
  
  //  update error display
  gpio_put(PIN_STATUS, error);
  // Serial.println(error);
  //  update stop display
  gpio_put(PIN_STOP_LED, (local_status & 0b00000001));
  gpio_put(PIN_SSTOP_LED, (local_status & 0b00000010));  


  // take action
  //int t0 = micros();
  display_status();
  //Serial.println((micros()-t0));
  Serial.println("End of loop.\n");
  Serial.println("    ");
  Serial.println("    ");
  
}
